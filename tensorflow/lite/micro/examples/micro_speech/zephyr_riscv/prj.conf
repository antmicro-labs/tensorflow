## CMakeLists.txt
```
cmake_minimum_required(VERSION 3.13.1)
find_package(Zephyr REQUIRED)
project(tf_lite_micro_speech)

set(TF_DIR ${PROJECT_SOURCE_DIR}/../../../../../../)
set(TF_LITE_DIR ${TF_DIR}/tensorflow/lite/)
set(TF_MICRO_DIR ${TF_DIR}/tensorflow/lite/micro/)

set(MICROFRONTEND ${TF_LITE_DIR}/experimental/microfrontend/lib/)
set(KISS_FFT ${TF_MICRO_DIR}/tools/make/downloads/kissfft/)

set(MICRO_SPEECH ${TF_MICRO_DIR}/examples/micro_speech/)
set(MICRO_FEATURES ${MICRO_SPEECH}/micro_features/)
set(SIMPLE_FEATURES ${MICRO_SPEECH}/simple_features/)

file(GLOB MICRO_SOURCES ${TF_MICRO_DIR}/*cc)
file(GLOB MICRO_HEADERS ${TF_MICRO_DIR}/*.h)
file(GLOB MICRO_TESTS_SOURCES ${TF_MICRO_DIR}/*test.cc)
file(GLOB MICRO_KERNELS_SOURCES ${TF_MICRO_DIR}/kernels/*cc)
file(GLOB MICRO_KERNELS_HEADERS ${TF_MICRO_DIR}/kernels/*.h)
file(GLOB MICRO_TESTS_KERNELS_SOURCES ${TF_MICRO_DIR}/kernels/*test.cc)
file(GLOB MICRO_MEMORY_SOURCES ${TF_MICRO_DIR}/memory_planner/*cc)
file(GLOB MICRO_MEMORY_HEADERS ${TF_MICRO_DIR}/memory_planner/*.h)
file(GLOB MICRO_TESTS_MEMORY_SOURCES ${TF_MICRO_DIR}/memory_planner/*test.cc)

list(REMOVE_ITEM MICRO_SOURCES ${MICRO_TESTS_SOURCES})
list(REMOVE_ITEM MICRO_KERNELS_SOURCES ${MICRO_TESTS_KERNELS_SOURCES})
list(REMOVE_ITEM MICRO_MEMORY_SOURCES ${MICRO_TESTS_MEMORY_SOURCES})

target_compile_options(app PRIVATE "-fno-threadsafe-statics")

target_sources(
  app
  PRIVATE ${MICRO_SOURCES}
          ${MICRO_KERNELS_SOURCES}
          ${MICRO_MEMORY_SOURCES}
          ${MICRO_HEADERS}
          ${MICRO_KERNEL_HEADERS}
          ${MICRO_MEMORY_HEADERS}
          ${TF_LITE_DIR}/c/common.c
          ${TF_LITE_DIR}/core/api/error_reporter.cc
          ${TF_LITE_DIR}/core/api/flatbuffer_conversions.cc
          ${TF_LITE_DIR}/core/api/op_resolver.cc
          ${TF_LITE_DIR}/core/api/tensor_utils.cc
          ${TF_LITE_DIR}/kernels/internal/quantization_util.cc
          ${TF_LITE_DIR}/kernels/kernel_util.cc
          # zephyr-src
          src/audio_provider.cc
          src/assistant_services.cc
          src/assistant_services.h
          src/command_responder.cc
          src/recognize_commands.h
          # micro_speech ${MICRO_SPEECH}/command_responder.cc
          ${MICRO_SPEECH}/command_responder.h
          # ${MICRO_SPEECH}/audio_provider.cc
          ${MICRO_SPEECH}/audio_provider.h
          ${MICRO_SPEECH}/feature_provider.cc
          ${MICRO_SPEECH}/feature_provider.h
          ${MICRO_SPEECH}/main.cc
          ${MICRO_SPEECH}/main_functions.cc
          ${MICRO_SPEECH}/main_functions.h
          ${MICRO_SPEECH}/recognize_commands.cc
          # ${MICRO_SPEECH}/recognize_commands.h
          ${MICRO_SPEECH}/no_1000ms_sample_data.cc
          ${MICRO_SPEECH}/no_1000ms_sample_data.h
          ${MICRO_SPEECH}/yes_1000ms_sample_data.cc
          ${MICRO_SPEECH}/yes_1000ms_sample_data.h
          # ${MICRO_SPEECH}/no_30ms_sample_data.cc
          # ${MICRO_SPEECH}/no_30ms_sample_data.h
          # ${MICRO_SPEECH}/yes_30ms_sample_data.cc
          # ${MICRO_SPEECH}/yes_30ms_sample_data.h micro_features
          ${MICRO_FEATURES}/tiny_conv_micro_features_model_data.cc
          ${MICRO_FEATURES}/tiny_conv_micro_features_model_data.h
          ${MICRO_FEATURES}/micro_model_settings.cc
          ${MICRO_FEATURES}/micro_model_settings.h
          ${MICRO_FEATURES}/micro_features_generator.cc
          ${MICRO_FEATURES}/micro_features_generator.h
          # ${MICRO_FEATURES}/yes_micro_features_data.cc
          # ${MICRO_FEATURES}/yes_micro_features_data.h
          # ${MICRO_FEATURES}/no_micro_features_data.cc
          # ${MICRO_FEATURES}/no_micro_features_data.h
          # ${MICRO_FEATURES}/no_feature_data_slice.cc
          # ${MICRO_FEATURES}/no_feature_data_slice.h
          # ${MICRO_FEATURES}/yes_feature_data_slice.cc
          # ${MICRO_FEATURES}/yes_feature_data_slice.h kiss_fft
          ${KISS_FFT}/kiss_fft.c
          ${KISS_FFT}/kiss_fft.h
          ${KISS_FFT}/_kiss_fft_guts.h
          ${KISS_FFT}/tools/kiss_fftr.c
          ${KISS_FFT}/tools/kiss_fftr.h
          # microfrontend
          ${MICROFRONTEND}/fft.cc
          ${MICROFRONTEND}/fft_util.cc
          ${MICROFRONTEND}/filterbank.c
          ${MICROFRONTEND}/filterbank_util.c
          ${MICROFRONTEND}/frontend.c
          ${MICROFRONTEND}/frontend_util.c
          ${MICROFRONTEND}/log_lut.c
          ${MICROFRONTEND}/log_scale.c
          ${MICROFRONTEND}/log_scale_util.c
          ${MICROFRONTEND}/noise_reduction.c
          ${MICROFRONTEND}/noise_reduction_util.c
          ${MICROFRONTEND}/pcan_gain_control.c
          ${MICROFRONTEND}/pcan_gain_control_util.c
          ${MICROFRONTEND}/window.c
          ${MICROFRONTEND}/window_util.c
          ${MICROFRONTEND}/bits.h
          ${MICROFRONTEND}/fft.h
          ${MICROFRONTEND}/fft_util
          ${MICROFRONTEND}/filterbank.h
          ${MICROFRONTEND}/filterbank_util.h
          ${MICROFRONTEND}/frontend.h
          ${MICROFRONTEND}/frontend_util.h
          ${MICROFRONTEND}/log_lut.h
          ${MICROFRONTEND}/log_scale.h
          ${MICROFRONTEND}/log_scale_util.h
          ${MICROFRONTEND}/noise_reduction.h
          ${MICROFRONTEND}/noise_reduction_util.h
          ${MICROFRONTEND}/pcan_gain_control.h
          ${MICROFRONTEND}/pcan_gain_control_util.h
          ${MICROFRONTEND}/window.h
          ${MICROFRONTEND}/window_util.h
  # simple_features ${SIMPLE_FEATURES}/simple_features_generator.cc
  # ${SIMPLE_FEATURES}/simple_features_generator.h
  # ${SIMPLE_FEATURES}/simple_model_settings.h
  # ${SIMPLE_FEATURES}/no_power_spectrum_data.cc
  # ${SIMPLE_FEATURES}/no_power_spectrum_data.h
  # ${SIMPLE_FEATURES}/yes_power_spectrum_data.cc
  # ${SIMPLE_FEATURES}/yes_power_spectrum_data.h
)

target_include_directories(
  app
  PRIVATE ${TF_DIR} ${TF_MICRO_DIR}/tools/make/downloads/ruy
          ${TF_LITE_DIR}/micro/tools/make/downloads/gemmlowp
          ${TF_MICRO_DIR}/tools/make/downloads/flatbuffers/include ${KISS_FFT})

add_compile_options(-DNDEBUG -DTF_LITE_STATIC_MEMORY)
```

## prj.conf
```kconfig
CONFIG_CPLUSPLUS=y
CONFIG_NEWLIB_LIBC=y
CONFIG_LOG=n
CONFIG_ETH_LITEETH=n
CONFIG_I2S_LITEX_DATA_BIG_ENDIAN=y
```

## boards/litex_vexriscv.overlay
```dts
&uart0 {

    reg = <0x82002000 0x18>;

    interrupts = <0x0 0>;

};

&timer0 {

    reg = <0x82002800 0x40>;

    interrupts = <0x1 0>;

};

&eth0 {
    status = "disabled";
};

&ram0 {
    reg = <0x40000000 0x10000000>;
};
```

## src/assert.cc
```c
extern "C" {

  void __assert_func (const char *, int, const char *, const char *) {
  }

}
```

## src/assistant_services.cc
```c
#include "assistant_services.h"

#include <kernel.h>
#include <sys/printk.h>

AssistantServices::AssistantServices()
    : currentActionID(ID_GET_WEATHER_STATUS),
      currentLightState(LightState::Off) {
}

void AssistantServices::sendOverUART(VoiceCommand command) const {
  switch (command) {
    case VoiceCommand::Yes:
      printk("\nVA:CMD:YES\n");
      break;
    case VoiceCommand::No:
      printk("\nVA:CMD:NO\n");
      break;
    case VoiceCommand::Up:
      printk("\nVA:CMD:UP\n");
      break;
    case VoiceCommand::Down:
      printk("\nVA:CMD:DOWN\n");
      break;
    case VoiceCommand::Left:
      printk("\nVA:CMD:LEFT\n");
      break;
    case VoiceCommand::Right:
      printk("\nVA:CMD:RIGHT\n");
      break;
    case VoiceCommand::On:
      printk("\nVA:CMD:ON\n");
      break;
    case VoiceCommand::Off:
      printk("\nVA:CMD:OFF\n");
      break;
    case VoiceCommand::Stop:
      printk("\nVA:CMD:STOP\n");
      break;
    case VoiceCommand::Go:
      printk("\nVA:CMD:GO\n");
      break;
    case VoiceCommand::Unknown:
      printk("\nVA:CMD:UNKNOWN\n");
      break;
    case VoiceCommand::Silence:
      printk("\nVA:IDLE\n");
      break;
    default:
      printk("VA:ERROR:ACTION_NOT_IMPLEMENTED\n");
      break;
  }
}

void AssistantServices::interpretVoiceCommand(VoiceCommand command) {
  if (command == VoiceCommand::Left || command == VoiceCommand::Right) {
    switch (command) {
      case VoiceCommand::Left:
        if (currentActionID > 0) {
          --currentActionID;
        }
      case VoiceCommand::Right:
        if (currentActionID < N_ACTIONS - 1) {
          ++currentActionID;
        }
      default:
        break;
    }
    printCurrentMenuState();
    return;
  }

  if (currentActionID == ID_SHOW_CURRENT_TIME && command == VoiceCommand::Go) {
    showCurrentTime();
  } else if (currentActionID == ID_GET_WEATHER_STATUS &&
             command == VoiceCommand::Go) {
    getWeatherStatus();
  } else if (currentActionID == ID_SET_LIGHT) {
    if (command == VoiceCommand::On) {
      setLight(LightState::On);
    } else if (command == VoiceCommand::Off) {
      setLight(LightState::Off);
    }
  }
}

void AssistantServices::printCurrentMenuState() const {
  printk("Current action: %s\n", actionStr[currentActionID]);
}

void AssistantServices::showCurrentTime() const {
  printk("Current system time: %ds\n", static_cast<int>(k_uptime_get() / 1000));
}

void AssistantServices::getWeatherStatus() const {
  printk("Weather in %s: %s\n", "Wroclaw", "cloudy");
}

char* lightState2Str(LightState state) {
  switch (state) {
    case LightState::On:
      return "on";
    case LightState::Off:
      return "off";
  }
  return "something went wrong";
}

void AssistantServices::setLight(LightState lightState) {
  currentLightState = lightState;
  printk("The light has been turned %s", lightState2Str(currentLightState));
}
```

## src/assistant_services.h
```c
#ifndef ASSISTANT_SERVICES_H
#define ASSISTANT_SERVICES_H

enum class VoiceCommand {
  Yes,
  No,
  Up,
  Down,
  Left,
  Right,
  On,
  Off,
  Stop,
  Go,
  Unknown,
  Silence
};

enum class LightState {
  On,
  Off
};

class AssistantServices {
 public:
  AssistantServices();
  void interpretVoiceCommand(VoiceCommand command);
  void sendOverUART(VoiceCommand command) const;

 private:
  const static int N_ACTIONS = 3;
  const static int ID_SHOW_CURRENT_TIME = 0;
  const static int ID_GET_WEATHER_STATUS = 1;
  const static int ID_SET_LIGHT = 2;
  char actionStr[N_ACTIONS][100] = {
    "Show current time", "Get weather status", "Set light"
  };

  void showCurrentTime() const;
  void getWeatherStatus() const;
  void setLight(LightState lightState);
  void printCurrentMenuState() const;

  int currentActionID;
  LightState currentLightState;
};

#endif  // ASSISTANT_SERVICES_H
```

## src/audio_provider.cc
```c
/* Copyright 2019 The TensorFlow Authors. All Rights Reserved.
Licensed under the Apache License, Version 2.0 (the "License");
you may not use this file except in compliance with the License.
You may obtain a copy of the License at
    http://www.apache.org/licenses/LICENSE-2.0
Unless required by applicable law or agreed to in writing, software
distributed under the License is distributed on an "AS IS" BASIS,
WITHOUT WARRANTIES OR CONDITIONS OF ANY KIND, either express or implied.
See the License for the specific language governing permissions and
limitations under the License.
==============================================================================*/

// TensorFlow Headers
#include "tensorflow/lite/micro/examples/micro_speech/audio_provider.h"

#include "tensorflow/lite/micro/examples/micro_speech/micro_features/micro_model_settings.h"
#include <zephyr.h>
#include <kernel.h>
#include <drivers/i2s.h>

namespace {

constexpr int MY_STACK_SIZE = 500;
constexpr int MY_PRIORITY = -1;

struct k_thread my_thread_data;
K_THREAD_STACK_DEFINE(my_stack_area, MY_STACK_SIZE);
constexpr int AUDIO_SAMPLES_PER_CH_PER_FRAME = 128;
constexpr int AUDIO_NUM_CHANNELS = 1;
constexpr int AUDIO_SAMPLES_PER_FRAME = 
        AUDIO_SAMPLES_PER_CH_PER_FRAME * AUDIO_NUM_CHANNELS;
constexpr int AUDIO_SAMPLE_BYTES = 2;
constexpr int AUDIO_SAMPLE_BIT_WIDTH = 16;

constexpr int AUDIO_FRAME_BUF_BYTES = 
        AUDIO_SAMPLES_PER_FRAME * AUDIO_SAMPLE_BYTES;
constexpr int I2S_PLAY_BUF_COUNT = 500;

bool g_is_audio_initialized = false;
constexpr int kAudioCaptureBufferSize = kAudioSampleFrequency*4;
int16_t g_audio_capture_buffer[kAudioCaptureBufferSize];
int16_t g_audio_output_buffer[kMaxAudioSampleSize];
int32_t g_latest_audio_timestamp = 0;

struct device *host_i2s_rx_dev;
struct k_mem_slab i2s_rx_mem_slab;
char rx_buffers[AUDIO_FRAME_BUF_BYTES * I2S_PLAY_BUF_COUNT];
struct i2s_config i2s_rx_cfg;

void CaptureSamples(const int16_t *sample_data) {
  const int sample_size = AUDIO_SAMPLES_PER_FRAME;
  const int32_t time_in_ms =
      g_latest_audio_timestamp + (sample_size / (kAudioSampleFrequency / 1000));
  const int32_t start_sample_offset =
      g_latest_audio_timestamp * (kAudioSampleFrequency / 1000);
  for (int i = 0; i < sample_size; ++i) {
    const int capture_index =
        (start_sample_offset + i) % kAudioCaptureBufferSize;
    g_audio_capture_buffer[capture_index] = sample_data[i];
  }
  // This is how we let the outside world know that new audio data has arrived.
  g_latest_audio_timestamp = time_in_ms;
}

void getAudio(void *, void *, void *)
{
    void *rx_mem_block;
    size_t size;
    while (1) {
       auto ret = i2s_read(host_i2s_rx_dev, &rx_mem_block, &size);
       CaptureSamples((int16_t*)rx_mem_block);
       k_mem_slab_free(&i2s_rx_mem_slab, &rx_mem_block);
    }
}

// Initalization for receiving audio data
TfLiteStatus InitAudioRecording(tflite::ErrorReporter *error_reporter) {
    int ret;
    //configure rx device
    host_i2s_rx_dev = device_get_binding("i2s_rx");
    if (!host_i2s_rx_dev) {
        error_reporter->Report("unable to find i2s_rx device");
        return kTfLiteError;
    }
    k_mem_slab_init(&i2s_rx_mem_slab, rx_buffers, AUDIO_FRAME_BUF_BYTES,
    I2S_PLAY_BUF_COUNT);

    /* configure i2s for audio playback */
    i2s_rx_cfg.word_size = AUDIO_SAMPLE_BIT_WIDTH;
    i2s_rx_cfg.channels = AUDIO_NUM_CHANNELS;
    i2s_rx_cfg.format = I2S_FMT_DATA_FORMAT_I2S;
    i2s_rx_cfg.options = I2S_OPT_FRAME_CLK_SLAVE;
    i2s_rx_cfg.frame_clk_freq = kAudioSampleFrequency;
    i2s_rx_cfg.block_size = AUDIO_FRAME_BUF_BYTES;
    i2s_rx_cfg.mem_slab = &i2s_rx_mem_slab;
    i2s_rx_cfg.timeout = -1;
    ret = i2s_configure(host_i2s_rx_dev, I2S_DIR_RX, &i2s_rx_cfg);

    if (ret != 0) {
        error_reporter->Report("i2s_configure failed with %d error", ret);
        return kTfLiteError;
    }
    /* start i2s rx driver */
    ret = i2s_trigger(host_i2s_rx_dev, I2S_DIR_RX, I2S_TRIGGER_START);
    if (ret != 0) {
        error_reporter->Report("i2s_trigger failed with %d error", ret);
        return kTfLiteError;
    }
    // creating thread problably can't failed 
    k_thread_create(&my_thread_data, my_stack_area,
                    K_THREAD_STACK_SIZEOF(my_stack_area),
                    getAudio,
                    NULL, NULL, NULL,
                    MY_PRIORITY, 0, K_NO_WAIT);
    error_reporter->Report("I2s cofigured");
    return kTfLiteOk;
}

}  // namespace

// Main entry point for getting audio data.
TfLiteStatus GetAudioSamples(tflite::ErrorReporter *error_reporter,
                             int start_ms, int duration_ms,
                             int *audio_samples_size, int16_t **audio_samples) {
    if (!g_is_audio_initialized) {
        TfLiteStatus init_status = InitAudioRecording(error_reporter);
        if (init_status != kTfLiteOk) {
            return init_status;
        }
        g_is_audio_initialized = true;
    }
    // This should only be called when the main thread notices that the latest
    // audio sample data timestamp has changed, so that there's new data in the
    // capture ring buffer. The ring buffer will eventually wrap around and
    // overwrite the data, but the assumption is that the main thread is checking
    // often enough and the buffer is large enough that this call will be made
    // before that happens.
    const int start_offset = start_ms * (kAudioSampleFrequency / 1000);
    const int duration_sample_count =
        duration_ms * (kAudioSampleFrequency / 1000);

    for (int i = 0; i < duration_sample_count; ++i) {
      const int capture_index = (start_offset + i) % kAudioCaptureBufferSize;
      g_audio_output_buffer[i] = g_audio_capture_buffer[capture_index];
    }
    *audio_samples_size = kMaxAudioSampleSize;
    *audio_samples = g_audio_output_buffer;
    return kTfLiteOk;
}

int32_t LatestAudioTimestamp() {
  return g_latest_audio_timestamp;
}
```

## src/command_responder.cc
```c
/* Copyright 2019 The TensorFlow Authors. All Rights Reserved.

Licensed under the Apache License, Version 2.0 (the "License");
you may not use this file except in compliance with the License.
You may obtain a copy of the License at

    http://www.apache.org/licenses/LICENSE-2.0

Unless required by applicable law or agreed to in writing, software
distributed under the License is distributed on an "AS IS" BASIS,
WITHOUT WARRANTIES OR CONDITIONS OF ANY KIND, either express or implied.
See the License for the specific language governing permissions and
limitations under the License.
==============================================================================*/

#include "tensorflow/lite/micro/examples/micro_speech/command_responder.h"

#include "assistant_services.h"
#include "string.h"

// Globals
static AssistantServices assistantServices;
namespace {
  volatile unsigned int* const led_r_address = (unsigned int*)0x82005800;
  volatile unsigned int* const led_g_address = (unsigned int*)0x82006000;
  volatile unsigned int* const led_b_address = (unsigned int*)0x82006800;
}  // namespace

static void setLeds(unsigned int led_r, unsigned int led_g, unsigned int led_b) {
  *led_r_address = led_r;
  *led_g_address = led_g;
  *led_b_address = led_b;
}

void RespondToCommand(tflite::ErrorReporter* error_reporter,
                      int32_t current_time, const char* found_command,
                      uint8_t score, bool is_new_command) {
  if (is_new_command) {
    VoiceCommand command;
    if (strcmp("yes", found_command) == 0) {
      setLeds(0, 0, 1);
      command = VoiceCommand::Yes;
    } else if (strcmp("no", found_command) == 0) {
      setLeds(0, 1, 0);
      command = VoiceCommand::No;
    } else if (strcmp("up", found_command) == 0) {
      setLeds(0, 0, 0);
      command = VoiceCommand::Up;
    } else if (strcmp("down", found_command) == 0) {
      setLeds(0, 0, 0);
      command = VoiceCommand::Down;
    } else if (strcmp("left", found_command) == 0) {
      setLeds(0, 1, 1);
      command = VoiceCommand::Left;
    } else if (strcmp("right", found_command) == 0) {
      setLeds(1, 0, 0);
      command = VoiceCommand::Right;
    } else if (strcmp("on", found_command) == 0) {
      setLeds(1, 0, 1);
      command = VoiceCommand::On;
    } else if (strcmp("off", found_command) == 0) {
      setLeds(1, 1, 0);
      command = VoiceCommand::Off;
    } else if (strcmp("stop", found_command) == 0) {
      setLeds(0, 0, 0);
      command = VoiceCommand::Stop;
    } else if (strcmp("go", found_command) == 0) {
      setLeds(1, 1, 1);
      command = VoiceCommand::Go;
    } else if (strcmp("unknown", found_command) == 0) {
      setLeds(0, 0, 0);
      command = VoiceCommand::Unknown;
    } else {
      setLeds(0, 0, 0);
      command = VoiceCommand::Silence;
    }
    assistantServices.sendOverUART(command);
  }
}
```
